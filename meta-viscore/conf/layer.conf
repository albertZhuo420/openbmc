## meta-viscore/conf/layer.conf
```bitbake
# We have a conf and classes directory, add to BBPATH
BBPATH .= ":${LAYERDIR}"

# We have recipes-* directories, add to BBFILES
BBFILES += "${LAYERDIR}/recipes-*/*/*.bb \
            ${LAYERDIR}/recipes-*/*/*.bbappend"

BBFILE_COLLECTIONS += "viscore"
# BBFILE_PATTERN_viscore := "^${LAYERDIR}/"
BBFILE_PATTERN_viscore = "^${LAYERDIR}/"
BBFILE_PRIORITY_viscore  = "6"

LAYERDEPENDS_viscore = "core"
LAYERSERIES_COMPAT_viscore := "honister kirkstone"
# BBFILE_COLLECTIONS += "facebook-layer"
# BBFILE_PATTERN_facebook-layer := "^${LAYERDIR}/"
# LAYERSERIES_COMPAT_facebook-layer := "honister kirkstone"
```

## meta-viscore/conf/machine/include/viscore-compute-multihost.inc
```bitbake
MACHINEOVERRIDES =. "viscore-compute-multihost:"
# MACHINEOVERRIDES =. "fb-compute-multihost:"

require conf/machine/include/viscore-compute.inc
# require conf/machine/include/facebook-compute.inc
```

## meta-viscore/conf/machine/include/viscore-compute-singlehost.inc
```bitbake
MACHINEOVERRIDES =. "viscore-compute-singlehost:"
# MACHINEOVERRIDES =. "fb-compute-singlehost:"

require conf/machine/include/viscore-compute.inc
# require conf/machine/include/facebook-compute.inc
```

## meta-viscore/conf/machine/include/viscore-compute.inc
```bitbake
MACHINEOVERRIDES =. "viscore-compute:"
#MACHINEOVERRIDES =. "fb-compute:"

require conf/machine/include/viscore-withhost.inc
#require conf/machine/include/facebook-withhost.inc
```

## meta-viscore/conf/machine/include/viscore-nohost.inc
```bitbake
MACHINEOVERRIDES =. "viscore-nohost:"
#MACHINEOVERRIDES =. "fb-nohost:"

require conf/machine/include/viscore.inc
#require conf/machine/include/facebook.inc
```

## meta-viscore/meta-pwfb/conf/layer.conf
```bitbake
# We have a conf and classes directory, add to BBPATH
BBPATH .= ":${LAYERDIR}"

# We have recipes-* directories, add to BBFILES
BBFILES += "${LAYERDIR}/recipes-*/*/*.bb \
            ${LAYERDIR}/recipes-*/*/*.bbappend"

BBFILE_COLLECTIONS += "pwfb"
# BBFILE_PATTERN_pwfb := "^${LAYERDIR}/"
BBFILE_PATTERN_pwfb = "^${LAYERDIR}/"

LAYERSERIES_COMPAT_pwfb := "honister kirkstone"
```
